## Trabalho-3/esp1/main/Kconfig.projbuild
```kconfig
menu "Configuração do Wifi"

    config ESP_WIFI_SSID
        string "WiFi SSID"
        default "ssid"
        help
            Nome da rede Wifi.

    config ESP_WIFI_PASSWORD
        string "Senha do Wifi"
        default "minha_senha"
        help
            Senha do WiFi (WPA or WPA2).

    config ESP_MAXIMUM_RETRY
        int "Número máximo de tentativas de conexão"
        default 5
        help
            Configure o valor máximo de tentativas de conexão.
endmenu

menu "Outros"
    config ESP_WIFI_PASSWORD
        string "Senha do Wifi"
        default "minha_senha"
        help
            Senha do WiFi (WPA or WPA2).
endmenu

menu "Operation Mode"
    config MODO_BATERIA
        int "Modo de Bateria"
        default 0
        range 0 1
        help
            Defina se o dispositivo deve iniciar em modo bateria ou não (Modo Bateria = 1, Modo Energia = 0)
endmenu
```

## Trabalho-3/esp2/main/Kconfig.projbuild
```kconfig
menu "Configuração do Wifi"

    config ESP_WIFI_SSID
        string "WiFi SSID"
        default "ssid"
        help
            Nome da rede Wifi.

    config ESP_WIFI_PASSWORD
        string "Senha do Wifi"
        default "minha_senha"
        help
            Senha do WiFi (WPA or WPA2).

    config ESP_MAXIMUM_RETRY
        int "Número máximo de tentativas de conexão"
        default 5
        help
            Configure o valor máximo de tentativas de conexão.
endmenu

menu "Modo de Energia"
    config ESP_MODO_BATERIA
        int  "Inicializar em Modo Bateria"
        default 0
        range 0 1
        help
            Defina se o dispositivo deve iniciar em modo bateria ou não (Modo Bateria = 1, Modo Energia = 0)
endmenu
```
